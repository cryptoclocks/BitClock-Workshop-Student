#include <Arduino.h>
#include "gameover.h"
#include <XPT2046_Bitbang.h>
#include "GlobalModule.h"
#include "GlobalParameter.h"
#include "GlobalFunction.h"
#include "time.h"
#include "page9.h"
#include "handle.h"
#include <HTTPClient.h>
#include <ArduinoJson.h>
#include <FS.h>
#include "JpgSupport.h"
#include <TFT_eSPI.h>
#define MAX_IMAGE_WIDTH 320
#include <esp_task_wdt.h>

TFT_eSprite img = TFT_eSprite(&tft);
TFT_eSprite img2 = TFT_eSprite(&tft);
TFT_eSprite e = TFT_eSprite(&tft);
TFT_eSprite e2 = TFT_eSprite(&tft);

//game
unsigned long startTime = 0;
int topScore = 0;
PROGMEM unsigned char dino[][1155] = {{
    0x00, 0x00, 0xF8, 0x3F, 0x00, 0x00, 0x00, 0xFC, 0x7F, 0x00, 0x00, 0x00,
    0xFE, 0xFF, 0x01, 0x00, 0x00, 0xEE, 0xFF, 0x01, 0x00, 0x00, 0xFE, 0xFF,
    0x01, 0x00, 0x00, 0xFE, 0xFF, 0x01, 0x00, 0x00, 0xFE, 0xFF, 0x01, 0x00,
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    0x00, 0x00, 0x00, 0x1E, 0x0F, 0x00, 0x00,
  }, {
    0x00, 0x00, 0xF8, 0x3F, 0x00, 0x00, 0x00, 0xFC, 0x7F, 0x00, 0x00, 0x00,
    0xFE, 0xFF, 0x01, 0x00, 0x00, 0xEE, 0xFF, 0x01, 0x00, 0x00, 0xFE, 0xFF,
    0x01, 0x00, 0x00, 0xFE, 0xFF, 0x01, 0x00, 0x00, 0xFE, 0xFF, 0x01, 0x00,
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    0x00, 0x00, 0x00, 0x1E, 0x00, 0x00, 0x00,
  }, {
    0x00, 0x00, 0xF8, 0x3F, 0x00, 0x00, 0x00, 0xFC, 0x7F, 0x00, 0x00, 0x00,
    0xFE, 0xFF, 0x01, 0x00, 0x00, 0xEE, 0xFF, 0x01, 0x00, 0x00, 0xFE, 0xFF,
    0x01, 0x00, 0x00, 0xFE, 0xFF, 0x01, 0x00, 0x00, 0xFE, 0xFF, 0x01, 0x00,
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    0x00, 0x00, 0x00, 0x00, 0x0F, 0x00, 0x00,
  }
};

PROGMEM unsigned char cloud[] = {
  0x00, 0x00, 0x7C, 0x00, 0x00, 0x00, 0x80, 0xCF, 0x01, 0x00, 0x00, 0xE0,
  0x01, 0x03, 0x00, 0x00, 0x60, 0x00, 0x0F, 0x00, 0x00, 0x38, 0x00, 0xFE,
  0x00, 0x00, 0x3C, 0x30, 0xA8, 0x03, 0xE0, 0x0F, 0x00, 0x80, 0x07, 0x70,
  0x05, 0x03, 0x00, 0x0E, 0x18, 0x00, 0x00, 0x02, 0x08, 0x0E, 0x00, 0x00,
  0x00, 0x18, 0xFF, 0xFF, 0xFF, 0xFF, 0x3F,
};

PROGMEM unsigned char bump[][170] = {{
    0xC0, 0x01, 0x00, 0x1E, 0x00, 0x30, 0x03, 0x00, 0x33, 0x00, 0x1C, 0x0E,
    0xC0, 0xE0, 0x00, 0x06, 0x18, 0xF0, 0x80, 0x01, 0x03, 0xF0, 0x1F, 0x00,
    0x03,
  }, {
    0x00, 0x00, 0x00, 0x00, 0x00, 0xC0, 0x01, 0x00, 0x00, 0x00, 0x30, 0x0E,
    0xC0, 0x00, 0x00, 0x18, 0x98, 0xF3, 0xC1, 0x01, 0x07, 0xF0, 0x1F, 0x3E,
    0x03,
  }
};

PROGMEM unsigned char enemy[][684] =  {{
    0x00, 0x03, 0x00, 0x80, 0x07, 0x00, 0xC0, 0x0F, 0x00, 0xC0, 0x0F, 0x00,
    0xC0, 0x0F, 0x00, 0xC0, 0x0F, 0x00, 0xC0, 0x0F, 0x00, 0xC0, 0x0F, 0x00,
    0xC0, 0x0F, 0x00, 0xC0, 0x0F, 0x00, 0xC0, 0x8F, 0x01, 0xC6, 0xCF, 0x03,
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    0xC0, 0x0F, 0x00, 0xC0, 0x0F, 0x00,
  }, {
    0x00, 0x00, 0x00, 0x00, 0x00, 0x00, 0x00, 0x00, 0x00, 0x00, 0x00, 0x00,
    0x00, 0x00, 0x00, 0x00, 0x01, 0x00, 0x80, 0x03, 0x00, 0xC0, 0x07, 0x00,
    0xC0, 0x07, 0x00, 0xC0, 0x07, 0x00, 0xC0, 0x47, 0x00, 0xC0, 0xE7, 0x00,
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    0xC0, 0x07, 0x00, 0xC0, 0x07, 0x00,
  }
};

const int pwmFreq = 5000;
const int pwmResolution = 8;
const int pwmLedChannelTFT = 0;

int dinoW = 33;
int dinoH = 35;
float linesX[6];
int linesW[6];
float linesX2[6];
int linesW2[6];
float clouds[2] = {random(0, 80), random(100, 180)};
float bumps[2];
int bumpsF[2];
int eW = 18;
int eH = 38;

float eX[2] = {random(320, 390), random(460, 540)};
int ef[2] = {0, 1};

float sped = 3;
int x = 30;
int y = 58;
float dir = -3;
bool pressed = 0;
int frames = 0;
int f = 0;
float cloudSpeed = 0.4;
bool gameRun = 1;
int score = 0;
int t = 0;
int press2 = 0;
byte b = 1;

//end game

void drawBushes() {
  // วาดพุ่มไม้ซ้าย
  tft.drawLine(90, 110, 90, 190, TFT_BLACK); // ลำต้นพุ่มไม้ซ้าย
  tft.drawCircle(90, 110, 15, TFT_BLACK); // ใบไม้พุ่มไม้ซ้าย
  tft.drawCircle(75, 125, 10, TFT_BLACK); // ใบไม้พุ่มไม้ซ้ายเพิ่ม
  tft.drawCircle(105, 125, 10, TFT_BLACK); // ใบไม้พุ่มไม้ซ้ายเพิ่ม

  // วาดพุ่มไม้ขวา
  tft.drawLine(230, 110, 230, 190, TFT_BLACK); // ลำต้นพุ่มไม้ขวา
  tft.drawCircle(230, 110, 15, TFT_BLACK); // ใบไม้พุ่มไม้ขวา
  tft.drawCircle(215, 125, 10, TFT_BLACK); // ใบไม้พุ่มไม้ขวาเพิ่ม
  tft.drawCircle(245, 125, 10, TFT_BLACK); // ใบไม้พุ่มไม้ขวาเพิ่ม
}


void showStartScreen() {
  tft.fillScreen(TFT_WHITE);
  // Draw Left Arrow
  drawArrow(30, 10, "left");

  // วาดกรอบสี่เหลี่ยมรอบชื่อเกม
  tft.drawRect(70, 20, 180, 50, TFT_BLACK);
  tft.setTextColor(TFT_BLACK);
  tft.fillRect(71, 21, 178, 48, TFT_WHITE); // สร้างพื้นหลังสีขาวภายในกรอบ

  // วาดชื่อเกมในกรอบ
  tft.setTextSize(1);
  tft.setTextColor(TFT_BLACK);
  tft.setTextDatum(MC_DATUM);
  tft.drawString("Dino Jump", 160, 48, 4);

  // วาดไดโนเสาร์
  //tft.drawXBitmap(144, 160, dino[0], 33, 35, TFT_BLACK, TFT_WHITE);

  // วาดต้นไม้ด้านข้างไดโนเสาร์
  drawBushes();

  // ข้อความเริ่มเกม
  tft.setTextSize(1);
  tft.setTextColor(TFT_DARKGREY);
  tft.setTextDatum(MC_DATUM);
  tft.drawString("- Tap to Start -", 160, 210, 4);
}



void jumpingDino() {
  static int y = 160; // ตำแหน่ง y เริ่มต้น
  static float dir = -3.0; // เพิ่มความเร็วในการกระโดด
  static bool jumping = true;

  tft.fillRect(144, y, 33, 35, TFT_WHITE); // ลบไดโนเสาร์เก่า
  y += dir;
  if (y <= 120) dir = 3.0; // กระโดดขึ้นให้สูงขึ้น
  if (y >= 160) dir = -3.0; // ลงถึงพื้นแล้วกระโดดใหม่

  tft.drawXBitmap(144, y, dino[0], 33, 35, TFT_BLACK, TFT_WHITE); // วาดไดโนเสาร์ใหม่
  delay(10); // ลดการหน่วงเวลาเพื่อเพิ่มความเร็วในการกระโดด
}


void drawS(int x, int y, int frame) {
  img.fillSprite(TFT_WHITE);
  img.drawLine(0, 134, 320, 134, TFT_BLACK);

  for (int i = 0; i < 6; i++) {
    img.drawLine(linesX[i], 137, linesX[i] + linesW[i], 137, TFT_BLACK);
    linesX[i] = linesX[i] - sped;
    if (linesX[i] < -14) {
      linesX[i] = random(325, 480);
      linesW[i] = random(1, 14);
    }
    img.drawLine(linesX2[i], 148, linesX2[i] + linesW2[i], 148, TFT_BLACK);
    linesX2[i] = linesX2[i] - sped;
    if (linesX2[i] < -14) {
      linesX2[i] = random(325, 480);
      linesW2[i] = random(1, 14);
    }
  }
  for (int j = 0; j < 2; j++) {
    img.drawXBitmap(clouds[j], 70, cloud, 38, 11, TFT_BLACK, TFT_WHITE);
    clouds[j] = clouds[j] - cloudSpeed;
    if (clouds[j] < -40)
      clouds[j] = random(324, 444);
  }

  for (int n = 0; n < 2; n++) {
    img.drawXBitmap(bumps[n], 130, bump[bumpsF[n]], 34, 5, TFT_BLACK, TFT_WHITE);
    bumps[n] = bumps[n] - sped;
    if (bumps[n] < -40) {
      int newBumpPosition;
      newBumpPosition = random(324, 720);
      if (abs(newBumpPosition - bumps[1 - n]) < 320)
      {
        newBumpPosition = bumps[1 - n] + 320 ;
      }


      bumps[n] = newBumpPosition;
      bumpsF[n] = random(0, 2);
    }
  }

  for (int m = 0; m < 2; m++) {
    eX[m] = eX[m] - sped;
    if (eX[m] < -20) {
      int newEXPosition;

      newEXPosition = random(320, 720);
      if (abs(newEXPosition - eX[1 - m]) < 320)
      {
        newEXPosition = eX[1 - m] + 320 ;
      }

      eX[m] = newEXPosition;
      ef[m] = random(0, 2);
    }
  }

  e.drawXBitmap(0, 0, enemy[0], eW, eH, TFT_BLACK, TFT_WHITE);
  e2.drawXBitmap(0, 0, enemy[1], eW, eH, TFT_BLACK, TFT_WHITE);
  img2.drawXBitmap(0, 0, dino[frame], 33, 35, TFT_BLACK, TFT_WHITE);

  e.pushToSprite(&img, eX[0], 106, TFT_WHITE);
  e2.pushToSprite(&img, eX[1], 106, TFT_WHITE);
  img2.pushToSprite(&img, x, y + 50, TFT_WHITE);

  score = (millis() - startTime) / 120; // คำนวณคะแนนโดยใช้ startTime
  img.drawString(String(score), 284, 0, 2);
  img.drawString("Top: " + String(topScore), 10, 0, 2); // แสดง top score
  img.pushSprite(0, 0);

  if (score > t + 40) { // ลดค่าเกณฑ์ในการตรวจสอบการเพิ่มความเร็ว
    t = score;
    sped = sped + 0.2; // เพิ่มอัตราการเพิ่มความเร็ว
    dir = -sped;
  }
}


void checkColision() {
  for (int i = 0; i < 2; i++) {
    if (eX[i] < x + dinoW / 2 && eX[i] > x && y > 25) {
      gameRun = 0;
      tft.fillRect(0, 30, 320, 110, TFT_WHITE);
      tft.drawXBitmap(45, 60, gameover, 223, 100, TFT_BLACK, TFT_WHITE);
      delay(500);

      // บันทึกคะแนนลงไฟล์ถ้าคะแนนมากกว่า top score
      if (score > topScore) {
        topScore = score;

        // สร้างอ็อบเจ็กต์ JSON
        DynamicJsonDocument doc(512);
        doc["game"] = "Dino Run"; // ชื่อเกม
        doc["topScore"] = topScore; // คะแนนสูงสุด

        // เปิดไฟล์ JSON สำหรับเขียนข้อมูล
        File file = SD.open("/"+firmwareVersion+"/system/data/topScore.json", FILE_WRITE);
        if (file) {
          serializeJsonPretty(doc, file);
          file.close();
          Serial.println("Top score saved successfully to /" + firmwareVersion +"/system/data/topScore.json");
        } else {
          Serial.println("Failed to open /" + firmwareVersion +"/system/data/topScore.json for writing");
        }
      }
    }
  }
}



void resetGame() {
  x = 30;
  y = 58;
  sped = 3;
  dir = -sped;
  pressed = 0;
  frames = 0;
  f = 0;
  cloudSpeed = 0.4;
  gameRun = 1;
  score = 0;
  t = 0;

  eX[0] = random(320, 490);

  eX[1] = random(640, 960);
  if (abs(eX[1] - eX[0]) < 320)
  {
    eX[1] = eX[0] + 320 ;
  }

  ef[0] = 0;
  ef[1] = 1;

  for (int i = 0; i < 6; i++) {
    linesX[i] = random(i * 40, (i + 1) * 80);
    linesW[i] = random(1, 14);
    linesX2[i] = random(i * 40, (i + 1) * 80);
    linesW2[i] = random(1, 14);
  }

  for (int n = 0; n < 2; n++) {
    bumps[n] = random(n * 180, (n + 1) * 240);
    bumpsF[n] = random(0, 2);
  }

  tft.fillScreen(TFT_WHITE);
  startTime = millis(); // ตั้งค่าเวลาเริ่มต้น
}

void setupPage8()
{
  img.setTextColor(TFT_BLACK, TFT_WHITE);
  img.setColorDepth(1);
  img2.setColorDepth(1);
  e.setColorDepth(1);
  e2.setColorDepth(1);

  img.createSprite(320, 240);
  img2.createSprite(33, 35);
  e.createSprite(eW, eH);
  e2.createSprite(eW, eH);

 

  // อ่าน top score จากไฟล์ JSON
  File file = SD.open("/"+firmwareVersion+"/system/data/topScore.json", FILE_READ);
  if (file) {
    DynamicJsonDocument doc(512);
    DeserializationError error = deserializeJson(doc, file);
    file.close();

    if (error) {
      Serial.println("Failed to parse /" + firmwareVersion +"/system/data/topScore.json");
      topScore = 0; // กำหนดค่าเริ่มต้นหากไฟล์อ่านไม่ได้
    } else {
      topScore = doc["topScore"] | 0; // อ่านค่า topScore จาก JSON
    }
  } else {
    Serial.println("Failed to open /" + firmwareVersion +"/system/data/topScore.json");
    topScore = 0; // กำหนดค่าเริ่มต้นหากไม่พบไฟล์
  }

  showStartScreen();
  gameRun = 0 ;

  delay(100);
}


void showPage8()
{


  if (gameRun == 1) {
    TouchPoint touch = checkTouchScreen();
    if (!(touch.zRaw == 0)) {
      pressed = 1;
      f = 0;
    }

    if (pressed == 1) {
      y = y + dir;
      if (y <= 8) { // ปรับขอบเขตการกระโดดลง 50 พิกเซล
        dir = sped;
      }
      if (y >= 58) { // ปรับขอบเขตการกระโดดลง 50 พิกเซล
        pressed = 0;
        dir = -sped;
        y = 58;
      }
    }

    if (frames < 8 && pressed == 0)
      f = 1;
    if (frames > 8 && pressed == 0)
      f = 2;

    drawS(x, y, f);
    frames++;
    if (frames == 16)
      frames = 0;

    checkColision();
  } else {

    TouchPoint touch1 = checkTouchScreen();
    showStartScreen();
    while ((touch1.zRaw == 0 )) {
      jumpingDino(); // เพิ่มการกระโดดของไดโนเสาร์
      touch1 = checkTouchScreen();
      if (touch1.x >= 0 && touch1.x <= 80 && touch1.y >= 0 && touch1.y <= 50 && touch1.zRaw != 0) {
        // Code for Left Arrow  // Back to Settings
        Serial.println("back to page9");
        pageIndex = 9 ;
        menuId = 0;
        showPage9();
        return;
      }
      delay(20);
      esp_task_wdt_reset();
    }
    delay(200);
    resetGame();
    gameRun = 1;
    score = 0 ;
    t = 0 ;

  }

}
